## main/Kconfig.projbuild
```kconfig
menu "MCP4922 Example Configuration"

    config MCP4922_MOSI_PIN
        int "MOSI GPIO Pin"
        default 11
        help
            GPIO pin for SPI MOSI.

    config MCP4922_SCK_PIN
        int "SCK GPIO Pin"
        default 12
        help
            GPIO pin for SPI SCK.

    config MCP4922_CS1_PIN
        int "Chip Select 1 GPIO Pin"
        default 10
        help
            GPIO pin for CS1.

    config MCP4922_CS2_PIN
        int "Chip Select 2 GPIO Pin"
        default 9
        help
            GPIO pin for CS2.

    config MCP4922_LDAC_PIN
        int "LDAC GPIO Pin"
        default 14
        help
            GPIO pin for LDAC.

endmenu
```
